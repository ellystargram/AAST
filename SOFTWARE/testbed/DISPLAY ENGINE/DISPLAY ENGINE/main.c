//AAST TOP SECRET
#define F_CPU 16000000

#include <avr/io.h>
#include <avr/interrupt.h>
#include <util/delay.h>

//CODE DEFAULT
#define TRUE 1
#define FALSE 0

//MAX7219 PIN
#define CS PB0
#define CLK PB1
#define DIN PB2

//MAX7219 CONTROL
#define MAX7219_NOP     0x00
#define MAX7219_DIGIT0  0x01
#define MAX7219_DIGIT1  0x02
#define MAX7219_DIGIT2  0x03
#define MAX7219_DIGIT3  0x04
#define MAX7219_DIGIT4  0x05
#define MAX7219_DIGIT5  0x06
#define MAX7219_DIGIT6  0x07
#define MAX7219_DIGIT7  0x08
#define MAX7219_DECODE  0x09
#define MAX7219_INTEN   0x0A
#define MAX7219_SCANLIM 0x0B
#define MAX7219_SHUTDOWN 0x0C
#define MAX7219_TEST    0x0F

void setup_(void);
void update_(void);
void cwrotate__(unsigned char* __origin);
void spisetup_(void);
void spitrans_(unsigned char _data);
void max7219_setup_(void);
void printmax7219_(unsigned char _adress, unsigned char _data);
void printcharviamax7219_(unsigned char _char);
void portbcontroler_(unsigned char _bit, unsigned char _logical_value);
unsigned char getbitofbyte_(unsigned char _byte, unsigned char _bit);


unsigned char _alphabet[52][8]={
	{0x00, 0xfc, 0x22, 0x21, 0x21, 0x22, 0xfc, 0x00},//A
	{0x00, 0xff, 0x89, 0x89, 0x89, 0x89, 0x76, 0x00},//B
	{0x00, 0x3c, 0x42, 0x81, 0x81, 0x42, 0x24, 0x00},//C
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	{0x00, 0x00, 0x90, 0xd0, 0xb0, 0x90, 0x00, 0x00},//z
};

int main(void){
	setup_();
	while(TRUE){
		update_();
		
	}
}

void setup_(void){
	for(unsigned char _rotate=0;_rotate<52;_rotate++){
		cwrotate__(_alphabet[_rotate]);
	}
	DDRB=(1<<CS)|(1<<DIN)|(1<<CLK);
	spisetup_();
	max7219_setup_();
	TCCR0=1;
	TIMSK=(1<<TOIE0);
	sei();
}
void update_(void){
	/*
	for(unsigned char _char=0;_char<52;_char++){
		printmax7219_(MAX7219_DIGIT0,)
		printcharviamax7219_(_char);
		_delay_ms(1000);
	}
	*/
	for(unsigned char _xstart=0;_xstart<48;_xstart++){
		for(unsigned char _y=0;_y<8;_y++){
			portbcontroler_(CS,FALSE);
			for(unsigned char _x=_xstart;_x<_xstart+4;_x++){
				printmax7219_(_y+1,_alphabet[_x][_y]);
			}
			portbcontroler_(CS,TRUE);
		}
		_delay_ms(1000);
	}
	
}
void cwrotate__(unsigned char* __origin){
	unsigned char _drawboard[8]={0,};
	for(unsigned char _y=0;_y<8;_y++){
		for(unsigned char _x=0;_x<8;_x++){
			_drawboard[_y]=_drawboard[_y]|(getbitofbyte_(__origin[_x],(7-_y))<<_x);
		}
	}
	for(unsigned char _duplicate=0;_duplicate<8;_duplicate++){
		__origin[_duplicate]=_drawboard[_duplicate];
	}
}
void spisetup_(void){
	SPCR=(1<<SPE)|(1<<SPR0)|(1<<MSTR);
}
void spitrans_(unsigned char _data){
	SPDR=_data;
	_delay_ms(1);
	while(!(SPSR&(1<<SPIF)));
}
void max7219_setup_(void) {
	portbcontroler_(CS,FALSE);
	for(unsigned char _repeat=0;_repeat<4;_repeat++){
		printmax7219_(MAX7219_TEST, 0x00);     // 테스트 모드 비활성화
	}
	portbcontroler_(CS,TRUE);
	
	portbcontroler_(CS,FALSE);
	for(unsigned char _repeat=0;_repeat<4;_repeat++){
		printmax7219_(MAX7219_SCANLIM, 0x07);   // 모든 자리 활성화 (0 ~ 7)
	}
	portbcontroler_(CS,TRUE);
	
	portbcontroler_(CS,FALSE);
	for(unsigned char _repeat=0;_repeat<4;_repeat++){
		printmax7219_(MAX7219_DECODE, 0x00);   // 디코더 모드 비활성화
	}
	portbcontroler_(CS,TRUE);
	
	portbcontroler_(CS,FALSE);
	for(unsigned char _repeat=0;_repeat<4;_repeat++){
		printmax7219_(MAX7219_INTEN, 0x00);    // 중단 모드 비활성화
	}
	portbcontroler_(CS,TRUE);
	
	portbcontroler_(CS,FALSE);
	for(unsigned char _repeat=0;_repeat<4;_repeat++){
		printmax7219_(MAX7219_SHUTDOWN, 0x01); // 셧다운 모드 해제
	}
	portbcontroler_(CS,TRUE);
	
	
	
	portbcontroler_(CS,TRUE);
}
void printmax7219_(unsigned char _adress, unsigned char _data){
	//portbcontroler_(CS,FALSE);
	spitrans_(_adress);
	spitrans_(_data);
	//portbcontroler_(CS,TRUE);
}
void printcharviamax7219_(unsigned char _char){
	for(unsigned char _digit=0;_digit<8;_digit++){
		printmax7219_(_digit+1,_alphabet[_char][_digit]);
	}
}
void portbcontroler_(unsigned char _bit, unsigned char _logical_value){
	unsigned char _newportb=0;
	for(unsigned char _digit=0;_digit<8;_digit++){
		if(_digit==_bit){
			_newportb=_newportb|(_logical_value<<_bit);
		}
		else{
			_newportb=_newportb|(PORTB&(1<<_digit));
		}
	}
	PORTB=_newportb;
}
unsigned char getbitofbyte_(unsigned char _byte, unsigned char _bit){
	return (_byte>>_bit)&0x01;
}

ISR(TIMER0_OVF_vect){
	
}